## CMakeLists.txt
```
cmake_minimum_required(VERSION 3.20.0)

set(BOARD nrf52840dk/nrf52840)


find_package(Zephyr REQUIRED HINTS $ENV{ZEPHYR_BASE})
project(base)

list(APPEND CMAKE_MODULE_PATH ${ZEPHYR_BASE}/modules/nanopb)
include(nanopb)

zephyr_nanopb_sources(app src/minecraftmessage.proto)

include_directories(inc/)
FILE(GLOB app_sources src/*.c)
target_sources(app PRIVATE ${app_sources})
```

## prj.conf
```kconfig
CONFIG_USB_DEVICE_STACK=y
CONFIG_USB_DEVICE_PRODUCT="Tellus Teal Minecraft Controller"
CONFIG_USB_DEVICE_PID=0x0003
CONFIG_USB_DEVICE_INITIALIZE_AT_BOOT=n
CONFIG_ENTROPY_GENERATOR=y
CONFIG_ENTROPY_DEVICE_RANDOM_GENERATOR=y

CONFIG_USB_DEVICE_HID=y
CONFIG_USB_HID_DEVICE_COUNT=2

CONFIG_LOG=n
CONFIG_USB_DRIVER_LOG_LEVEL_INF=y
CONFIG_USB_DEVICE_LOG_LEVEL_INF=y

CONFIG_SERIAL=y
CONFIG_UART_LINE_CTRL=y

CONFIG_GPIO=y
CONFIG_UART_INTERRUPT_DRIVEN=y

CONFIG_NANOPB=y

# BT + Event Group
CONFIG_EVENTS=y
CONFIG_BT=y
CONFIG_BT_CENTRAL=y
CONFIG_BOOT_BANNER=n
```

## src/main.c
```c
/**
 **************************************************************
 * @file src/main.c
 * @author Lewis Luck - 46983932
 * @date 02052024
 * @brief Main entry point that initialises systems
 * REFERENCE: N/A
 **************************************************************
 */

#include "hid.h"
#include "nanopb_serial.h"

#define SETUP_SLEEP_TIME_MS 100

int main(void) {
  init_nanopb(); 
  
  return 0;
}

K_THREAD_DEFINE(hid_control, 1024, hid_control_thread, NULL, NULL, NULL,
                3, 0, 0);

				
```

## inc/hid.h
```c
#ifndef HID_H
#define HID_H

#include <zephyr/kernel.h>
#include <zephyr/device.h>
#include <zephyr/drivers/gpio.h>
#include <zephyr/drivers/uart.h>
#include <string.h>
#include <zephyr/random/random.h>

#include <zephyr/usb/usb_device.h>
#include <zephyr/usb/class/usb_hid.h>
#include <zephyr/usb/class/usb_cdc.h>

#define KEYBOARD_COMMANDS_INDEX 10
#define MOUSE_COMMANDS_INDEX 16

enum evt_t {
    KBD_FORWARD	        = 0x00,
    KBD_BACKWARD	    = 0x01,
    KBD_LEFT            = 0x02,
    KBD_RIGHT           = 0x03,
    KBD_ONE             = 0x04,
    KBD_TWO             = 0x05,
    KBD_THREE           = 0x06,
    KBD_FOUR            = 0x07,
    KBD_FIVE            = 0x08,
    KBD_SPACE           = 0x09,
    KBD_CLEAR	        = 0x0A,
	MOUSE_UP		    = 0x0B,
	MOUSE_DOWN	        = 0x0C,
	MOUSE_LEFT	        = 0x0D,
	MOUSE_RIGHT	        = 0x0E,
	MOUSE_CLEAR	        = 0x0F,
    MOUSE_LEFT_CLICK    = 0x10,
    MOUSE_RIGHT_CLICK   = 0x20
}; 

struct app_evt_t {
	sys_snode_t node;
	enum evt_t event_type;
};

extern void app_evt_add_new_command(enum evt_t event_type);

extern void clear_mouse_report(void);

extern void clear_kbd_report(void);

extern void hid_control_thread(void);

#endif
```

## inc/nanopb_serial.h
```c
#ifndef PB_H
#define PB_D

#include <stdio.h>
#include <string.h>
#include <zephyr/kernel.h>
#include <zephyr/drivers/gpio.h>
#include <zephyr/drivers/uart.h>
#include <zephyr/sys/printk.h>
#include <zephyr/sys/byteorder.h>
#include <pb_encode.h>
#include <pb_decode.h>
#include "src/minecraftmessage.pb.h"

extern void init_nanopb(void);

#endif
```

## src/bt_handler.c
```c
/**
 ******************************************************************************
 * @file bt_handler.c
 * @author Lewis Young
 * @date 14/52024 
 * @brief Scans packets from thingy52 checking for pb presses 
 ******************************************************************************
 **/

#include <stdio.h>
#include <string.h>
#include <zephyr/drivers/uart.h>
#include <zephyr/kernel.h>
#include <zephyr/bluetooth/bluetooth.h>
#include <zephyr/bluetooth/hci.h>
#include <zephyr/bluetooth/conn.h>
#include <zephyr/bluetooth/uuid.h>
#include <zephyr/bluetooth/gatt.h>
#include <zephyr/sys/byteorder.h>
#include "hid.h"  

char *mobileAddr = "D4:02:7A:07:85:21"; // BT Address of Thingy:52

#define PUSH_BUTTON_STATE_INDEX 28 // Index of pb state byte in ble packet
#define PB_EVENT_BIT 0x001
static uint8_t pbState = 0; // prev state of the pb 

K_EVENT_DEFINE(pbEvent); // event group 

/*
 * BT scanner callback function; scans set ble address and checks for the byte
 * that indicates the pb state in the payload, if the byte is toggled, an event
 * bit is set to indicate the button is pressed.
 */
static void device_found(const bt_addr_le_t *addr, int8_t rssi, uint8_t type,
                         struct net_buf_simple *ad) {
  char addr_str[BT_ADDR_LE_STR_LEN];

  bt_addr_le_to_str(addr, addr_str, sizeof(addr_str));

  if (memcmp(mobileAddr, addr_str, 17) == 0) {
 
    if(pbState != (uint8_t)ad->data[PUSH_BUTTON_STATE_INDEX]) {
      
      pbState = (uint8_t)ad->data[PUSH_BUTTON_STATE_INDEX];
     
      k_event_set(&pbEvent, PB_EVENT_BIT);      
    }
  }
}

/*
 * Thread to handle the ble; inits the ble hardware and scanner, then waits
 * for the event bit to be set that indicates a press.
 */
void ble_thread(void) {

  uint32_t events;

  bt_enable(NULL); 

  struct bt_le_scan_param scan_param = {
      .type = BT_LE_SCAN_TYPE_PASSIVE,
      .options = BT_LE_SCAN_OPT_NONE,
      .interval = BT_GAP_SCAN_FAST_INTERVAL,
      .window = BT_GAP_SCAN_FAST_WINDOW,
  };

  bt_le_scan_start(&scan_param, device_found);
  
  while (true) {

    events = k_event_wait(&pbEvent, PB_EVENT_BIT, false, K_FOREVER);

    if(events & 0x001) {

      app_evt_add_new_command(MOUSE_RIGHT_CLICK);
      clear_mouse_report();
      printk("1\n");
      k_event_clear(&pbEvent, PB_EVENT_BIT);
    }
  }

}

K_THREAD_DEFINE(ble, 2048, ble_thread, NULL, NULL, NULL, 1, 0, 0);
```

## src/hid.c
```c
/*
 * Copyright (c) 2019 Nordic Semiconductor ASA
 *
 * SPDX-License-Identifier: Apache-2.0
 */
#include "hid.h"

#define LOG_LEVEL LOG_LEVEL_DBG
LOG_MODULE_REGISTER(hid);

#define SW0_NODE DT_ALIAS(sw0)

#if DT_NODE_HAS_STATUS(SW0_NODE, okay)
static const struct gpio_dt_spec sw0_gpio = GPIO_DT_SPEC_GET(SW0_NODE, gpios);
#endif

#define SW1_NODE DT_ALIAS(sw1)

#if DT_NODE_HAS_STATUS(SW1_NODE, okay)
static const struct gpio_dt_spec sw1_gpio = GPIO_DT_SPEC_GET(SW1_NODE, gpios);
#endif

#define SW2_NODE DT_ALIAS(sw2)

#if DT_NODE_HAS_STATUS(SW2_NODE, okay)
static const struct gpio_dt_spec sw2_gpio = GPIO_DT_SPEC_GET(SW2_NODE, gpios);
#endif

#define SW3_NODE DT_ALIAS(sw3)

#if DT_NODE_HAS_STATUS(SW3_NODE, okay)
static const struct gpio_dt_spec sw3_gpio = GPIO_DT_SPEC_GET(SW3_NODE, gpios);
#endif

/* Event FIFO */

K_FIFO_DEFINE(evt_fifo);

#define FIFO_ELEM_MIN_SZ        sizeof(struct app_evt_t)
#define FIFO_ELEM_MAX_SZ        sizeof(struct app_evt_t)
#define FIFO_ELEM_COUNT         255
#define FIFO_ELEM_ALIGN         sizeof(unsigned int)

K_HEAP_DEFINE(event_elem_pool, FIFO_ELEM_MAX_SZ * FIFO_ELEM_COUNT + 256);

/* HID */
static const struct device *hid0_dev, *hid1_dev;
static const uint8_t hid_mouse_report_desc[] = HID_MOUSE_REPORT_DESC(2);
static const uint8_t hid_kbd_report_desc[] = HID_KEYBOARD_REPORT_DESC();
static char mapEvtToChar[10] = {'w', 's', 'a', 'd', '1', '2', '3', '4', '5', 'j'};

static K_SEM_DEFINE(evt_sem, 0, 1);	/* starts off "not available" */
static K_SEM_DEFINE(usb_sem, 1, 1);	/* starts off "available" */
static struct gpio_callback gpio_callbacks[4];

#define MOUSE_BTN_REPORT_POS	0
#define MOUSE_X_REPORT_POS	1
#define MOUSE_Y_REPORT_POS	2

#define MOUSE_BTN_LEFT		BIT(0)
#define MOUSE_BTN_RIGHT		BIT(1)
#define MOUSE_BTN_MIDDLE	BIT(2)

static inline void app_evt_free(struct app_evt_t *ev)
{
	k_heap_free(&event_elem_pool, ev);
}

static inline void app_evt_put(struct app_evt_t *ev)
{
	k_fifo_put(&evt_fifo, ev);
}

static inline struct app_evt_t *app_evt_get(void)
{
	return k_fifo_get(&evt_fifo, K_NO_WAIT);
}

static inline void app_evt_flush(void)
{
	struct app_evt_t *ev;

	do {
		ev = app_evt_get();
		if (ev) {
			app_evt_free(ev);
		}
	} while (ev != NULL);
}

static inline struct app_evt_t *app_evt_alloc(void)
{
	struct app_evt_t *ev;

	ev = k_heap_alloc(&event_elem_pool,
			  sizeof(struct app_evt_t),
			  K_NO_WAIT);
	if (ev == NULL) {
		LOG_ERR("APP event allocation failed!");
		app_evt_flush();

		ev = k_heap_alloc(&event_elem_pool,
				  sizeof(struct app_evt_t),
				  K_NO_WAIT);
		if (ev == NULL) {
			LOG_ERR("APP event memory corrupted.");
			__ASSERT_NO_MSG(0);
			return NULL;
		}
		return NULL;
	}

	return ev;
}

void app_evt_add_new_command(enum evt_t event_type) {
    struct app_evt_t *ev2 = app_evt_alloc();
    ev2->event_type = event_type,
    app_evt_put(ev2);
    k_sem_give(&evt_sem);
}

static void in_ready_cb(const struct device *dev)
{
	ARG_UNUSED(dev);

	k_sem_give(&usb_sem);
}

static const struct hid_ops ops = {
	.int_in_ready = in_ready_cb,
};

void clear_mouse_report(void)
{
	struct app_evt_t *new_evt = app_evt_alloc();

	new_evt->event_type = MOUSE_CLEAR;
	app_evt_put(new_evt);
	k_sem_give(&evt_sem);

	//printk("Clearing mouse");
}

void clear_kbd_report(void)
{
	struct app_evt_t *new_evt = app_evt_alloc();

	new_evt->event_type = KBD_CLEAR;
	app_evt_put(new_evt);
	k_sem_give(&evt_sem);

	//printk("Clearing keyboard");
}

static int ascii_to_hid(uint8_t ascii)
{
	if (ascii < 32) {
		/* Character not supported */
		return -1;
	} else if (ascii < 48) {
		/* Special characters */
		switch (ascii) {
		case 32:
			return HID_KEY_SPACE;
		case 33:
			return HID_KEY_1;
		case 34:
			return HID_KEY_APOSTROPHE;
		case 35:
			return HID_KEY_3;
		case 36:
			return HID_KEY_4;
		case 37:
			return HID_KEY_5;
		case 38:
			return HID_KEY_7;
		case 39:
			return HID_KEY_APOSTROPHE;
		case 40:
			return HID_KEY_9;
		case 41:
			return HID_KEY_0;
		case 42:
			return HID_KEY_8;
		case 43:
			return HID_KEY_EQUAL;
		case 44:
			return HID_KEY_COMMA;
		case 45:
			return HID_KEY_MINUS;
		case 46:
			return HID_KEY_DOT;
		case 47:
			return HID_KEY_SLASH;
		default:
			return -1;
		}
	} else if (ascii < 58) {
		/* Numbers */
		if (ascii == 48U) {
			return HID_KEY_0;
		} else {
			return ascii - 19;
		}
	} else if (ascii < 65) {
		/* Special characters #2 */
		switch (ascii) {
		case 58:
			return HID_KEY_SEMICOLON;
		case 59:
			return HID_KEY_SEMICOLON;
		case 60:
			return HID_KEY_COMMA;
		case 61:
			return HID_KEY_EQUAL;
		case 62:
			return HID_KEY_DOT;
		case 63:
			return HID_KEY_SLASH;
		case 64:
			return HID_KEY_2;
		default:
			return -1;
		}
	} else if (ascii < 91) {
		/* Uppercase characters */
		return ascii - 61U;
	} else if (ascii < 97) {
		/* Special characters #3 */
		switch (ascii) {
		case 91:
			return HID_KEY_LEFTBRACE;
		case 92:
			return HID_KEY_BACKSLASH;
		case 93:
			return HID_KEY_RIGHTBRACE;
		case 94:
			return HID_KEY_6;
		case 95:
			return HID_KEY_MINUS;
		case 96:
			return HID_KEY_GRAVE;
		default:
			return -1;
		}
	} else if (ascii < 123) {
		/* Lowercase letters */
		return ascii - 93;
	} else if (ascii < 128) {
		/* Special characters #4 */
		switch (ascii) {
		case 123:
			return HID_KEY_LEFTBRACE;
		case 124:
			return HID_KEY_BACKSLASH;
		case 125:
			return HID_KEY_RIGHTBRACE;
		case 126:
			return HID_KEY_GRAVE;
		case 127:
			return HID_KEY_DELETE;
		default:
			return -1;
		}
	}

	return -1;
}

static bool needs_shift(uint8_t ascii)
{
	if ((ascii < 33) || (ascii == 39U)) {
		return false;
	} else if ((ascii >= 33U) && (ascii < 44)) {
		return true;
	} else if ((ascii >= 44U) && (ascii < 58)) {
		return false;
	} else if ((ascii == 59U) || (ascii == 61U)) {
		return false;
	} else if ((ascii >= 58U) && (ascii < 91)) {
		return true;
	} else if ((ascii >= 91U) && (ascii < 94)) {
		return false;
	} else if ((ascii == 94U) || (ascii == 95U)) {
		return true;
	} else if ((ascii > 95) && (ascii < 123)) {
		return false;
	} else if ((ascii > 122) && (ascii < 127)) {
		return true;
	} else {
		return false;
	}
}

/* Devices */

static void btn0(const struct device *gpio, struct gpio_callback *cb,
		 uint32_t pins)
{
	app_evt_add_new_command(KBD_FORWARD);
    clear_kbd_report();
}

#if DT_NODE_HAS_STATUS(SW1_NODE, okay)
static void btn1(const struct device *gpio, struct gpio_callback *cb,
		 uint32_t pins)
{
	app_evt_add_new_command(KBD_BACKWARD);
    clear_kbd_report();
}
#endif

#if DT_NODE_HAS_STATUS(SW2_NODE, okay)
static void btn2(const struct device *gpio, struct gpio_callback *cb,
		 uint32_t pins)
{
	app_evt_add_new_command(MOUSE_LEFT_CLICK);
    clear_mouse_report();
}
#endif

#if DT_NODE_HAS_STATUS(SW3_NODE, okay)
static void btn3(const struct device *gpio, struct gpio_callback *cb,
		 uint32_t pins)
{
	app_evt_add_new_command(MOUSE_RIGHT_CLICK);
    clear_mouse_report();
}
#endif

int callbacks_configure(const struct gpio_dt_spec *gpio,
			void (*handler)(const struct device *, struct gpio_callback*,
					uint32_t),
			struct gpio_callback *callback)
{
	if (!device_is_ready(gpio->port)) {
		LOG_ERR("%s: device not ready.", gpio->port->name);
		return -ENODEV;
	}

	gpio_pin_configure_dt(gpio, GPIO_INPUT);

	gpio_init_callback(callback, handler, BIT(gpio->pin));
	gpio_add_callback(gpio->port, callback);
	gpio_pin_interrupt_configure_dt(gpio, GPIO_INT_EDGE_TO_ACTIVE);

	return 0;
}

static void status_cb(enum usb_dc_status_code status, const uint8_t *param)
{
	LOG_INF("Status %d", status);
}

static void transmit_key(char character) {
	//printk("Sending |%c|\n", character);
    int ch = ascii_to_hid(character);

    if (ch == -1) {
        LOG_WRN("Unsupported character: %d", character);
    } else {
        uint8_t rep[] = {0x00, 0x00, 0x00, 0x00,
                    0x00, 0x00, 0x00, 0x00};
        if (needs_shift(character)) {
            rep[0] |=
            HID_KBD_MODIFIER_RIGHT_SHIFT;
        }
        rep[7] = ch;

        k_sem_take(&usb_sem, K_FOREVER);
        hid_int_ep_write(hid1_dev, rep,
                sizeof(rep), NULL);
    }
}

#define DEVICE_AND_COMMA(node_id) DEVICE_DT_GET(node_id),

void hid_control_thread(void)
{
	struct app_evt_t *ev;
	int ret;

	/* Configure devices */

	hid0_dev = device_get_binding("HID_0");
	if (hid0_dev == NULL) {
		LOG_ERR("Cannot get USB HID 0 Device");
		return;
	}

	hid1_dev = device_get_binding("HID_1");
	if (hid1_dev == NULL) {
		LOG_ERR("Cannot get USB HID 1 Device");
		return;
	}

	if (callbacks_configure(&sw0_gpio, &btn0, &gpio_callbacks[0])) {
		LOG_ERR("Failed configuring button 0 callback.");
		return;
	}

#if DT_NODE_HAS_STATUS(SW1_NODE, okay)
	if (callbacks_configure(&sw1_gpio, &btn1, &gpio_callbacks[1])) {
		LOG_ERR("Failed configuring button 1 callback.");
		return;
	}
#endif

#if DT_NODE_HAS_STATUS(SW2_NODE, okay)
	if (callbacks_configure(&sw2_gpio, &btn2, &gpio_callbacks[2])) {
		LOG_ERR("Failed configuring button 2 callback.");
		return;
	}
#endif

#if DT_NODE_HAS_STATUS(SW3_NODE, okay)
	if (callbacks_configure(&sw3_gpio, &btn3, &gpio_callbacks[3])) {
		LOG_ERR("Failed configuring button 3 callback.");
		return;
	}
#endif

	/* Initialize HID */

	usb_hid_register_device(hid0_dev, hid_mouse_report_desc,
				sizeof(hid_mouse_report_desc), &ops);

	usb_hid_register_device(hid1_dev, hid_kbd_report_desc,
				sizeof(hid_kbd_report_desc), &ops);

	usb_hid_init(hid0_dev);
	usb_hid_init(hid1_dev);

	ret = usb_enable(status_cb);
	if (ret != 0) {
		LOG_ERR("Failed to enable USB");
		return;
	} 

	while (true) {

		k_sem_take(&evt_sem, K_FOREVER);

		while ((ev = app_evt_get()) != NULL) {

            if (ev->event_type < KEYBOARD_COMMANDS_INDEX) {
                char command_char = mapEvtToChar[ev->event_type];
                LOG_INF("Keyboard command: %c", command_char);
                LOG_INF("Keyboard command: %d", ev->event_type);
                transmit_key(command_char);
            } else if (ev->event_type == KBD_CLEAR) {
                /* Clear kbd report */
				uint8_t rep[] = {0x00, 0x00, 0x00, 0x00,
					      0x00, 0x00, 0x00, 0x00};

				k_sem_take(&usb_sem, K_FOREVER);
				hid_int_ep_write(hid1_dev, rep,
						 sizeof(rep), NULL);
            } else if (ev->event_type < MOUSE_COMMANDS_INDEX) {
                uint8_t rep[] = {0x00, 0x00, 0x00, 0x00};
                switch (ev->event_type) {
                    case MOUSE_UP:
                        rep[MOUSE_Y_REPORT_POS] = 0xF0;
                        break;
                    case MOUSE_DOWN:
                        rep[MOUSE_Y_REPORT_POS] = 0x10;
                        break;
                    case MOUSE_LEFT:
                        rep[MOUSE_X_REPORT_POS] = 0xF0;
                        break;
                    case MOUSE_RIGHT:
                        rep[MOUSE_X_REPORT_POS] = 0x10;
                        break;
                    default:
                        break;
                }
				k_sem_take(&usb_sem, K_FOREVER);
				hid_int_ep_write(hid0_dev, rep,
						 sizeof(rep), NULL);
            } else if (ev->event_type == MOUSE_CLEAR) {
                /* Clear mouse report */
				uint8_t rep[] = {0x00, 0x00, 0x00, 0x00};

				k_sem_take(&usb_sem, K_FOREVER);
				hid_int_ep_write(hid0_dev, rep,
						 sizeof(rep), NULL);
            } else if (ev->event_type == MOUSE_LEFT_CLICK) {
                /* Press left mouse button */
				uint8_t rep[] = {0x00, 0x00, 0x00, 0x00};

				rep[MOUSE_BTN_REPORT_POS] |= MOUSE_BTN_LEFT;
				k_sem_take(&usb_sem, K_FOREVER);
				hid_int_ep_write(hid0_dev, rep,
						 sizeof(rep), NULL);
            } else if (ev->event_type == MOUSE_RIGHT_CLICK) {
                /* Press right mouse button */
				uint8_t rep[] = {0x00, 0x00, 0x00, 0x00};

				rep[MOUSE_BTN_REPORT_POS] |= MOUSE_BTN_RIGHT;
				k_sem_take(&usb_sem, K_FOREVER);
				hid_int_ep_write(hid0_dev, rep,
						 sizeof(rep), NULL);
            } else {
                LOG_ERR("Invalid character command received");
            }

			app_evt_free(ev);
		}
	}
}
```

## src/nanopb_serial.c
```c
#include "nanopb_serial.h"
#include "hid.h"
#include "src/minecraftmessage.pb.h"
#include "zephyr/kernel.h"
#include <zephyr/sys_clock.h>
#include <zephyr/sys/time_units.h>

#define THREAD_DELAY 1
#define LOOK_UPDATE_RATE 50 // ms

LOG_MODULE_REGISTER(nanopb);
static const struct gpio_dt_spec led0 = GPIO_DT_SPEC_GET(DT_ALIAS(led0), gpios);
static const struct device *const uart = DEVICE_DT_GET(DT_NODELABEL(uart0));

int64_t last_movement_time = 0;

static enum evt_t executing_movement_event = KBD_CLEAR;
static enum evt_t executing_look_event = MOUSE_CLEAR;
static bool looking_now = false;

void look_gesture(enum evt_t event) {
  looking_now = true;
  executing_look_event = event;
  clear_mouse_report();
}

void look_update_thread() {
  while (true) {
    if (looking_now) {
      app_evt_add_new_command(executing_look_event);
      clear_mouse_report();
    }
    k_msleep(LOOK_UPDATE_RATE);
  }
}

void interpret_gesture(GestureType gesture) {
  looking_now = false;
  switch (gesture) {
    case GestureType_LEFT_CLICK:
      app_evt_add_new_command(MOUSE_LEFT_CLICK);
      break;
    case GestureType_LOOK_LEFT:
      look_gesture(MOUSE_LEFT);
      break;
    case GestureType_LOOK_RIGHT:
      look_gesture(MOUSE_RIGHT);
      break;
    case GestureType_ONE:
      app_evt_add_new_command(KBD_ONE);
      clear_kbd_report();
      break;
    case GestureType_TWO:
      app_evt_add_new_command(KBD_TWO);
      clear_kbd_report();
      break;
    case GestureType_THREE:
      app_evt_add_new_command(KBD_THREE);
      clear_kbd_report();
      break;
    case GestureType_FOUR:
      app_evt_add_new_command(KBD_FOUR);
      clear_kbd_report();
      break;
    case GestureType_FIVE:
      app_evt_add_new_command(KBD_FIVE);
      clear_kbd_report();
      break;
    case GestureType_JUMP:
      ////printk("Got jump");
      app_evt_add_new_command(KBD_SPACE);
      break;
    case GestureType_LOOK_UP:
      look_gesture(MOUSE_UP);
      break;
    case GestureType_LOOK_DOWN:
      look_gesture(MOUSE_DOWN);
      break;
    default:
      clear_kbd_report();
      clear_mouse_report();
  }
}

void interpret_position(int32_t x, int32_t y) {
  enum evt_t event;
  if (y == 1) {
    //printk("Got backward");
    event = KBD_BACKWARD;
  } else if (y == 3) {
    //printk("Got forward");
    event = KBD_FORWARD;
  } else if (x == 1) {
    //printk("Got left");
    event = KBD_LEFT;
  } else if (x == 3) {
    //printk("Got right");
    event = KBD_RIGHT;
  } else {
    //printk("Got centre");
    event = KBD_CLEAR;
  }

  if (event != executing_movement_event) {
    //printk("New command, clearing");
    clear_kbd_report();
    app_evt_add_new_command(event);
    executing_movement_event = event;
  }
}

void interpret_message(MinecraftMessage message) {
  if (message.message_type == MessageType_BOTH 
   || message.message_type == MessageType_ULTRASONIC) {
    interpret_position(message.x_ultrasonic, message.y_ultrasonic);
  }
  
  if (message.message_type == MessageType_BOTH 
  || message.message_type == MessageType_GESTURE) {
    interpret_gesture(message.gesture);
  }
}

void uart_rx_cb(const struct device *dev, void *user_data) {
    
    uint8_t c;
    static uint8_t count = 0;
    static uint8_t rx_buffer[128];
    static uint32_t rx_index = 0;

    if (!uart_irq_update(uart)) {
        return;
    }
    if (!uart_irq_rx_ready(uart)) {
        return;
    }

    while (uart_fifo_read(uart, &c, 1) == 1) {   
      if(count == 0) {
        rx_index = c;
        count++;

      } else {
        
    
        rx_buffer[count - 1] = c;

        count++;
       
   
        if (rx_index == (count - 1)) {
            
            MinecraftMessage message = MinecraftMessage_init_zero;
            pb_istream_t istream = pb_istream_from_buffer(rx_buffer, rx_index);
            if (!pb_decode(&istream, MinecraftMessage_fields, &message)) {
                LOG_ERR("Error decoding message\n");
        
                count = 0;
                break;
            }

            interpret_message(message);

            // //printk("Message Type: %d\n", message.message_type);
            // //printk("Gesture: %d\n", message.gesture);
            // //printk("X Ultrasonic: %d\n", message.x_ultrasonic);
            // //printk("Y Ultrasonic: %d\n", message.y_ultrasonic);
            count = 0;
            
        }
      }
 
  }
}

void init_nanopb(void) {
    int ret;
    if (!gpio_is_ready_dt(&led0)) {
        return; 
    }

    ret = gpio_pin_configure_dt(&led0, GPIO_OUTPUT_ACTIVE);
    if (ret < 0) {
        return;
    }

    uart_irq_callback_user_data_set(uart, uart_rx_cb, NULL);
    uart_irq_rx_enable(uart);

    return;
}

K_THREAD_DEFINE(pan_update_thread, 2048, look_update_thread, NULL, NULL, NULL, 4, 0, 0);
```
