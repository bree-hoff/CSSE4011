## CMakeLists.txt
```
cmake_minimum_required(VERSION 3.20.0)

set(BOARD nrf52840dk/nrf52840)


find_package(Zephyr REQUIRED HINTS $ENV{ZEPHYR_BASE})
project(base)

list(APPEND CMAKE_MODULE_PATH ${ZEPHYR_BASE}/modules/nanopb)
include(nanopb)

zephyr_nanopb_sources(app src/minecraftmessage.proto)

FILE(GLOB app_sources src/*.c)
target_sources(app PRIVATE ${app_sources})
```

## prj.conf
```kconfig
CONFIG_NANOPB=y
CONFIG_SERIAL=y
CONFIG_UART_INTERRUPT_DRIVEN=y
CONFIG_GPIO=y


# BT + Event Group
CONFIG_EVENTS=y
CONFIG_BT=y
CONFIG_BT_CENTRAL=y
CONFIG_BOOT_BANNER=n
```

## nrf52840dk_nrf52840.overlay
```dts
arduino_serial: &uart1 {
    status = "okay";
	current-speed = <115200>;
	pinctrl-0 = <&uart1_default>;
	pinctrl-1 = <&uart1_sleep>;
	pinctrl-names = "default", "sleep";
};
```

## src/main.c
```c
#include <stdio.h>
#include <string.h>
#include <zephyr/kernel.h>
#include <zephyr/drivers/gpio.h>
#include <zephyr/drivers/uart.h>
#include <zephyr/sys/printk.h>
#include <zephyr/sys/byteorder.h>
#include <pb_encode.h>
#include <pb_decode.h>
#include "src/minecraftmessage.pb.h"

#define THREAD_DELAY 1

static const struct gpio_dt_spec led0 = GPIO_DT_SPEC_GET(DT_ALIAS(led0), gpios);

static const struct device *const uart = DEVICE_DT_GET(DT_NODELABEL(uart0));



void uart_rx_cb(const struct device *dev, void *user_data) {
    
    uint8_t c;
    static uint8_t count = 0;
    static uint8_t rx_buffer[128];
    static uint32_t rx_index = 0;

    if (!uart_irq_update(uart)) {
        return;
    }
    if (!uart_irq_rx_ready(uart)) {
        return;
    }

    while (uart_fifo_read(uart, &c, 1) == 1) {

      printk("Got %c at count %d\n",c, count);    

      if(count == 0) {
        rx_index = c;
        printk("rx index: %d\n",rx_index); 
        count++;

      } else {
        
    
        rx_buffer[count - 1] = c;

        count++;
       
   
        if (rx_index == (count - 1)) {
            
            MinecraftMessage message = MinecraftMessage_init_zero;
            pb_istream_t istream = pb_istream_from_buffer(rx_buffer, rx_index);
            if (!pb_decode(&istream, MinecraftMessage_fields, &message)) {
                printk("Error decoding message\n");
        
                count = 0;
                break;
            }

            printk("Message Type: %d\n", message.message_type);
            printk("Gesture: %d\n", message.gesture);
            printk("X Ultrasonic: %d\n", message.x_ultrasonic);
            printk("Y Ultrasonic: %d\n", message.y_ultrasonic);
            count = 0;
            
        }
       
        
      }
 
  }
}

int main(void) {
    int ret;
    if (!gpio_is_ready_dt(&led0)) {
        return 0; 
    }

    ret = gpio_pin_configure_dt(&led0, GPIO_OUTPUT_ACTIVE);
    if (ret < 0) {
        return 0;
    }

    uart_irq_callback_user_data_set(uart, uart_rx_cb, NULL);
    uart_irq_rx_enable(uart);

    while (true) {

        k_msleep(THREAD_DELAY);
    }

    return 0;
}
```

## src/bt_handler.c
```c
/**
 ******************************************************************************
 * @file bt_handler.c
 * @author Lewis Young
 * @date 14/52024 
 * @brief Scans packets from thingy52 checking for pb presses 
 ******************************************************************************
 **/

#include <stdio.h>
#include <string.h>
#include <zephyr/drivers/uart.h>
#include <zephyr/kernel.h>
#include <zephyr/bluetooth/bluetooth.h>
#include <zephyr/bluetooth/hci.h>
#include <zephyr/bluetooth/conn.h>
#include <zephyr/bluetooth/uuid.h>
#include <zephyr/bluetooth/gatt.h>
#include <zephyr/sys/byteorder.h>

char *mobileAddr = "D4:02:7A:07:85:21"; // BT Address of Thingy:52

#define PUSH_BUTTON_STATE_INDEX 28 // Index of pb state byte in ble packet
#define PB_EVENT_BIT 0x001
static uint8_t pbState = 0; // prev state of the pb 

K_EVENT_DEFINE(pbEvent); // event group 

/*
 * BT scanner callback function; scans set ble address and checks for the byte
 * that indicates the pb state in the payload, if the byte is toggled, an event
 * bit is set to indicate the button is pressed.
 */
static void device_found(const bt_addr_le_t *addr, int8_t rssi, uint8_t type,
                         struct net_buf_simple *ad) {
  char addr_str[BT_ADDR_LE_STR_LEN];

  bt_addr_le_to_str(addr, addr_str, sizeof(addr_str));

  if (memcmp(mobileAddr, addr_str, 17) == 0) {
 
    if(pbState != (uint8_t)ad->data[PUSH_BUTTON_STATE_INDEX]) {
      
      pbState = (uint8_t)ad->data[PUSH_BUTTON_STATE_INDEX];
     
      k_event_set(&pbEvent, PB_EVENT_BIT);      
    }
  }
}

/*
 * Thread to handle the ble; inits the ble hardware and scanner, then waits
 * for the event bit to be set that indicates a press.
 */
void ble_thread(void) {

  uint32_t events;

  bt_enable(NULL); 

  struct bt_le_scan_param scan_param = {
      .type = BT_LE_SCAN_TYPE_PASSIVE,
      .options = BT_LE_SCAN_OPT_NONE,
      .interval = BT_GAP_SCAN_FAST_INTERVAL,
      .window = BT_GAP_SCAN_FAST_WINDOW,
  };

  bt_le_scan_start(&scan_param, device_found);
  
  while (true) {

    events = k_event_wait(&pbEvent, PB_EVENT_BIT, false, K_FOREVER);

    if(events & 0x001) {

      printk("PB Pressed\n");
      k_event_clear(&pbEvent, PB_EVENT_BIT);
    }
  }

}

K_THREAD_DEFINE(ble, 2048, ble_thread, NULL, NULL, NULL, 10, 0, 0);
```
